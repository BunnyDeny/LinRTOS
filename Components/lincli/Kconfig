## Components/lincli/Kconfig
```kconfig
menu "LinCLI (Command Line Interface)"

source "Components/lincli/src/cli/Kconfig"
source "Components/lincli/src/third_party/Kconfig"

endmenu
```

## arch/Kconfig
```kconfig
menu "Architecture (ARM Cortex-M)"

choice ARCH_CPU_TYPE
    prompt "ARM Cortex-M core type"
    default ARCH_CPU_CORTEX_M4
    help
      Select the target ARM Cortex-M core. This determines the
      instruction set architecture and available hardware features.

config ARCH_CPU_CORTEX_M3
    bool "Cortex-M3"
    help
      ARMv7-M architecture. No FPU.

config ARCH_CPU_CORTEX_M4
    bool "Cortex-M4"
    help
      ARMv7-M architecture with optional single-precision FPU (M4F).

config ARCH_CPU_CORTEX_M7
    bool "Cortex-M7"
    help
      ARMv7-M architecture with optional single/double-precision FPU.

config ARCH_CPU_CORTEX_M33
    bool "Cortex-M33"
    help
      ARMv8-M Mainline architecture with optional TrustZone and FPU.
endchoice

config ARCH_ENABLE_FPU
    bool "Enable FPU support"
    default y
    depends on ARCH_CPU_CORTEX_M4 || ARCH_CPU_CORTEX_M7 || ARCH_CPU_CORTEX_M33
    help
      Enable FPU (floating-point unit) context save/restore on task switch.
      Only available on cores that have an optional FPU.
      Ensure your build flags include the correct -mfloat-abi and -mfpu settings.

choice ARCH_COMPILER
    prompt "Compiler toolchain"
    default ARCH_COMPILER_GCC
    help
      Select the compiler toolchain used to build the project.
      Note: the port layer assembly/C code currently uses GCC-style
      inline assembly. Full MDK/IAR porting may require additional
      adaptations in port.c and port_asm.S.

config ARCH_COMPILER_GCC
    bool "GCC (GNU toolchain)"
    help
      GNU Compiler Collection (e.g. arm-none-eabi-gcc).
      Uses standard GCC inline assembly syntax.

config ARCH_MDK_AC5
    bool "MDK — ARM Compiler 5 (armcc)"
    help
      Legacy ARM Compiler 5 shipped with Keil MDK.
      Requires embedded assembly syntax in port.c.

config ARCH_MDK_AC6
    bool "MDK — ARM Compiler 6 (armclang, LLVM-based)"
    help
      Modern Clang-based toolchain shipped with Keil MDK.
      Compatible with GCC-style inline assembly (shares the same
      port layer code path as GCC). Defines both __ARMCC_VERSION
      and __clang__.

config ARCH_COMPILER_IAR
    bool "IAR Embedded Workbench"
    help
      IAR C/C++ Compiler for ARM (iccarm).
endchoice

endmenu
```

## components/Kconfig
```kconfig
menu "Components"

config COMPONENT_CM_BACKTRACE
    bool "Enable CmBacktrace fault diagnosis"
    default y
    help
      Integrate CmBacktrace for HardFault diagnosis and call stack backtrace.
      When enabled, CmBacktrace source files are always compiled, but their
      contents are conditionally compiled via the component macro.

config CM_BACKTRACE_FIRMWARE_NAME
    string "CmBacktrace firmware name"
    default "LinRTOS_CmBacktrace"
    depends on COMPONENT_CM_BACKTRACE
    help
      Firmware name displayed in CmBacktrace fault output and used in the
      addr2line hint command.

endmenu
```

## configs/LinRTOS_defconfig
```kconfig
#
# Architecture (ARM Cortex-M)
#
CONFIG_ARCH_CPU_CORTEX_M4=y
CONFIG_ARCH_ENABLE_FPU=y
CONFIG_ARCH_COMPILER_GCC=y
# end of Architecture (ARM Cortex-M)

#
# LinRTOS Kernel
#
CONFIG_RTOS_MAX_PRIORITIES=32
CONFIG_RTOS_TICK_RATE_HZ=1000
CONFIG_RTOS_MAX_TASK_NAME_LEN=16
CONFIG_RTOS_ENABLE_TIME_SLICING=y
CONFIG_RTOS_TIME_SLICE_TICKS=100
# CONFIG_RTOS_ENABLE_IDLE_HOOK is not set
CONFIG_RTOS_MAX_TASKS=16
CONFIG_RTOS_IDLE_STACK_SIZE=64
# end of LinRTOS Kernel

#
# LinCLI (Command Line Interface)
#
CONFIG_CLI_ENABLE_USER=y
CONFIG_CLI_ENABLE_ENV=y
CONFIG_CLI_ENABLE_VAR=y
CONFIG_CLI_ENABLE_ADVANCED_COMPLETION=y
CONFIG_CLI_ENABLE_HELP=y
CONFIG_CLI_ENABLE_CMD_CHAIN=y
CONFIG_CLI_ENABLE_AUTO_RUN=y
CONFIG_HISTORY_MAX=4
CONFIG_DISPLAY_MAX_COWS=50
CONFIG_CLI_CMD_BUF_SIZE=128
CONFIG_CLI_MPOOL_COUNT=6
# end of LinCLI (Command Line Interface)
```

## src/Kconfig
```kconfig
menu "LinRTOS Kernel"

config RTOS_MAX_PRIORITIES
	int "Maximum number of priorities (1-64)"
	range 1 64
	default 32
	help
	  Number of priority levels. Must be <= 64.

config RTOS_TICK_RATE_HZ
	int "System tick rate (Hz)"
	default 1000
	help
	  SysTick interrupt frequency.

config RTOS_MAX_TASK_NAME_LEN
	int "Maximum task name length"
	default 16
	help
	  Including null terminator.

config RTOS_ENABLE_TIME_SLICING
	bool "Enable time slicing"
	default y
	help
	  Round-robin scheduling among same-priority tasks.

config RTOS_TIME_SLICE_TICKS
	int "Time slice length (ticks)"
	default 100
	depends on RTOS_ENABLE_TIME_SLICING
	help
	  Number of ticks before switching to next same-priority task.

config RTOS_ENABLE_IDLE_HOOK
	bool "Enable idle hook"
	default n
	help
	  Call user-provided hook function in idle task.

config RTOS_MAX_TASKS
	int "Maximum number of tasks"
	default 16
	help
	  Size of the static TCB pool.

config RTOS_IDLE_STACK_SIZE
	int "Idle task stack size (words)"
	default 128
	help
	  Stack size in uint32_t words.

endmenu
```

## tests/Kconfig
```kconfig
menuconfig ENABLE_TEST_CASES
	bool "Enable test cases"
	default n
	help
	  When enabled, you can select any number of test cases to build.
	  Each test registers itself via a linker section; test_runner.c
	  iterates the section and runs every registered test sequentially.
	  Results are printed to serial.  No per-test re-flash needed.

if ENABLE_TEST_CASES

config TEST_STATE
	bool "Task state query"
	help
	  Verify rtos_task_get_state / get_priority / get_current.

config TEST_MUTEX_BASIC
	bool "Mutex basic (take/give/ownership)"
	help
	  Verify rtos_mutex_init, take, give, holder query,
	  and non-holder give rejection.

config TEST_MUTEX_RECURSIVE
	bool "Mutex recursive (nested take/give)"
	help
	  Verify rtos_mutex_init_recursive, take_recursive,
	  give_recursive, count tracking, and blocking.

config TEST_MUTEX_PRIORITY
	bool "Mutex priority inheritance"
	help
	  Verify priority boosting when high-priority task
	  blocks on mutex held by low-priority task.

config TEST_SEMAPHORE_BINARY
	bool "Semaphore binary (give/take)"
	help
	  Verify rtos_semaphore_init_binary, give, take,
	  and producer-consumer synchronization.

config TEST_SEMAPHORE_COUNTING
	bool "Semaphore counting (multi producer)"
	help
	  Verify rtos_semaphore_init_counting, multi-give,
	  multi-take, and max-count boundary.

config TEST_SEMAPHORE_ISR
	bool "Semaphore ISR-safe give_from_isr"
	help
	  Verify rtos_semaphore_give_from_isr in SysTick
	  interrupt context with a consumer task.

config TEST_QUEUE_BASIC
	bool "Queue basic API (send/recv/front/overwrite/peek)"
	help
	  Verify rtos_queue_init, send, recv, front-insert,
	  overwrite, peek, and status query APIs.

config TEST_QUEUE_BLOCKING
	bool "Queue blocking and timeout"
	help
	  Verify blocking send/recv, producer-consumer sync,
	  and timeout behaviors.

config TEST_QUEUE_ISR
	bool "Queue ISR-safe send_from_isr"
	help
	  Verify rtos_queue_generic_send_from_isr in SysTick
	  interrupt context with a consumer task.

config TEST_SUSPEND_RESUME
	bool "Task suspend and resume (external)"
	help
	  Verify rtos_task_suspend / rtos_task_resume APIs
	  with external control.

config TEST_SELF_SUSPEND
	bool "Task self-suspend suspend(NULL)"
	help
	  Verify rtos_task_suspend(NULL) self-suspend
	  and external resume.

config TEST_PRIORITY
	bool "Dynamic priority change"
	help
	  Verify rtos_task_set_priority and preemption
	  after priority change.

config TEST_SELFDELETE
	bool "Self-delete and TCB recycle"
	help
	  Verify self-delete with idle task TCB recycle
	  and reuse by subsequent rtos_task_create.

config TEST_SCHED_LOCK
	bool "Scheduler lock single/nested"
	help
	  Verify rtos_sched_lock / rtos_sched_unlock,
	  single-level and nested locking.

config TEST_YIELD
	bool "Task yield (same-priority round-robin)"
	help
	  Verify rtos_task_yield alternation between
	  same-priority tasks.

config TEST_DELAY_UNTIL
	bool "Absolute periodic delay (delay_until)"
	help
	  Verify rtos_task_delay_until periodic accuracy.

config TEST_STACK_FREE
	bool "Stack free query"
	help
	  Verify rtos_task_get_stack_free returns
	  a reasonable value within bounds.

config TEST_ABORT_DELAY
	bool "Abort delay (force wake blocked task)"
	help
	  Verify rtos_task_abort_delay wakes a blocked
	  task and rtos_scheduler_is_running reports true.

config TEST_FPU
	bool "FPU context switch (Cortex-M4F)"
	help
	  Multi-task preemption with FPU register verification.
	  Requires FPU hardware.

config TEST_CM_BACKTRACE
	bool "CmBacktrace integration"
	depends on COMPONENT_CM_BACKTRACE
	help
	  Verify CmBacktrace initialization, call stack backtrace,
	  and firmware info output.

config TEST_WORKQUEUE
	bool "Workqueue scheduling"
	depends on WORKQUEUE
	help
	  Verify immediate and delayed work scheduling.

config TEST_BASIC_TASKS
	bool "Basic multi-task + delay + preemption"
	help
	  Visual test: multi-task creation, delay, delay_until,
	  and priority preemption.  Best observed via serial log.

endif
```
